## pinephone-kali-rom/config/kernel_defconfig
```kconfig
# PinePhone Kali NetHunter Kernel Config
# Base: Allwinner A64 (sun50i) + NetHunter pentesting features
# No modem/telephony support

# Architecture
CONFIG_ARCH_SUNXI=y
CONFIG_ARM64=y
CONFIG_SMP=y
CONFIG_NR_CPUS=4

# SoC / Clock / Power
CONFIG_SUN50I_A64_CCU=y
CONFIG_SUN50I_DE2_BUS=y
CONFIG_SUNXI_RSB=y
CONFIG_MFD_AXP20X=y
CONFIG_MFD_AXP20X_RSB=y
CONFIG_MFD_AXP20X_I2C=y

# Power Supply / Battery / Charging (AXP803 PMIC)
CONFIG_POWER_SUPPLY=y
CONFIG_AXP20X_POWER=y
CONFIG_AXP20X_ADC=y
CONFIG_AXP20X_AC_POWER=y
CONFIG_AXP20X_BATTERY=y
CONFIG_CHARGER_AXP20X=y
CONFIG_BATTERY_AXP20X=y
CONFIG_AXP20X_USB_POWER=y
CONFIG_INPUT_AXP20X_PEK=y

# Regulators
CONFIG_REGULATOR=y
CONFIG_REGULATOR_AXP20X=y
CONFIG_REGULATOR_FIXED_VOLTAGE=y
CONFIG_REGULATOR_GPIO=y

# Thermal / CPU Frequency Scaling
CONFIG_THERMAL=y
CONFIG_THERMAL_OF=y
CONFIG_CPU_THERMAL=y
CONFIG_SUN8I_THERMAL=y
CONFIG_THERMAL_DEFAULT_GOV_STEP_WISE=y
CONFIG_THERMAL_GOV_STEP_WISE=y
CONFIG_THERMAL_GOV_POWER_ALLOCATOR=y
CONFIG_CPU_FREQ=y
CONFIG_CPU_FREQ_DEFAULT_GOV_ONDEMAND=y
CONFIG_CPU_FREQ_GOV_PERFORMANCE=y
CONFIG_CPU_FREQ_GOV_POWERSAVE=y
CONFIG_CPU_FREQ_GOV_ONDEMAND=y
CONFIG_CPU_FREQ_GOV_CONSERVATIVE=y
CONFIG_CPU_FREQ_GOV_SCHEDUTIL=y
CONFIG_CPUFREQ_DT=y
CONFIG_ARM_ALLWINNER_SUN50I_CPUFREQ_NVMEM=y

# Suspend / PM
CONFIG_SUSPEND=y
CONFIG_PM=y
CONFIG_PM_SLEEP=y
CONFIG_PM_WAKELOCKS=y
CONFIG_PM_DEBUG=y

# RTC (required for wake-from-suspend)
CONFIG_RTC_CLASS=y
CONFIG_RTC_DRV_SUN6I=y

# I2C (required for PMIC communication)
CONFIG_I2C=y
CONFIG_I2C_MV64XXX=y
CONFIG_I2C_CHARDEV=y

# USB PHY (required for USB charging detection)
CONFIG_PHY_SUN4I_USB=y
CONFIG_PHY_ALLWINNER_USB=y

# Watchdog
CONFIG_SUNXI_WATCHDOG=y

# Display
CONFIG_DRM=y
CONFIG_DRM_SUN4I=y
CONFIG_DRM_SUN8I_MIXER=y
CONFIG_DRM_SUN8I_DW_HDMI=m
CONFIG_DRM_PANEL_SIMPLE=y
CONFIG_DRM_PANEL_XINGBANGDA_XBD599=y
CONFIG_BACKLIGHT_CLASS_DEVICE=y
CONFIG_BACKLIGHT_PWM=y
CONFIG_FB=y
CONFIG_FB_SIMPLE=y
CONFIG_FRAMEBUFFER_CONSOLE=y

# Touchscreen
CONFIG_TOUCHSCREEN_GOODIX=m
CONFIG_INPUT_TOUCHSCREEN=y

# Audio
CONFIG_SOUND=y
CONFIG_SND=y
CONFIG_SND_SOC=y
CONFIG_SND_SUN4I_CODEC=m
CONFIG_SND_SUN50I_CODEC_ANALOG=m
CONFIG_SND_SUN8I_CODEC_ANALOG=m

# LEDs / Vibration
CONFIG_LEDS_CLASS=y
CONFIG_LEDS_GPIO=m
CONFIG_INPUT_GPIO_VIBRA=m
CONFIG_INPUT_MISC=y

# GPIO / Pinctrl
CONFIG_PINCTRL_SUN50I_A64=y
CONFIG_GPIO_SYSFS=y
CONFIG_GPIOLIB=y

# USB Host + OTG
CONFIG_USB=y
CONFIG_USB_EHCI_HCD=y
CONFIG_USB_EHCI_HCD_PLATFORM=y
CONFIG_USB_OHCI_HCD=y
CONFIG_USB_OHCI_HCD_PLATFORM=y
CONFIG_USB_MUSB_HDRC=y
CONFIG_USB_MUSB_SUNXI=y
CONFIG_USB_OTG=y
CONFIG_USB_STORAGE=m

# =============================================
# NETHUNTER: USB Gadget Framework
# =============================================
CONFIG_USB_GADGET=y
CONFIG_USB_GADGET_VBUS_DRAW=500
CONFIG_USB_CONFIGFS=y
CONFIG_USB_CONFIGFS_SERIAL=y
CONFIG_USB_CONFIGFS_ACM=y
CONFIG_USB_CONFIGFS_NCM=y
CONFIG_USB_CONFIGFS_ECM=y
CONFIG_USB_CONFIGFS_RNDIS=y
CONFIG_USB_CONFIGFS_MASS_STORAGE=y
CONFIG_USB_CONFIGFS_F_HID=y
CONFIG_USB_CONFIGFS_F_UVC=y
CONFIG_USB_CONFIGFS_F_PRINTER=y
CONFIG_USB_CONFIGFS_F_FS=y
CONFIG_USB_FUNCTIONFS=m
CONFIG_USB_MASS_STORAGE=m

# =============================================
# NETHUNTER: Wireless / WiFi Injection
# =============================================
CONFIG_WIRELESS=y
CONFIG_CFG80211=m
CONFIG_CFG80211_WEXT=y
CONFIG_CFG80211_DEFAULT_PS=y
CONFIG_MAC80211=m
CONFIG_MAC80211_MESH=y
CONFIG_MAC80211_LEDS=y
CONFIG_MAC80211_RC_MINSTREL=y
CONFIG_WLAN=y

# PinePhone built-in WiFi (RTL8723CS via SDIO)
CONFIG_RTL8723CS=m
CONFIG_RTW88=m
CONFIG_RTW88_SDIO=m
CONFIG_RTW88_8723CS=m

# External USB WiFi adapters for injection
CONFIG_RTL8187=m
CONFIG_RTL8192CU=m
CONFIG_RTL8XXXU=m
CONFIG_RTL8XXXU_UNTESTED=y
CONFIG_ATH9K_HTC=m
CONFIG_ATH9K_HTC_DEBUGFS=y
CONFIG_MT76_USB=m
CONFIG_MT7601U=m
CONFIG_MT76x0U=m
CONFIG_MT76x2U=m
CONFIG_RT2X00=m
CONFIG_RT2800USB=m
CONFIG_RT73USB=m
CONFIG_ZD1211RW=m
CONFIG_CARL9170=m
CONFIG_AR5523=m
CONFIG_B43=m
CONFIG_BRCMFMAC=m

# =============================================
# NETHUNTER: Bluetooth
# =============================================
CONFIG_BT=m
CONFIG_BT_RFCOMM=m
CONFIG_BT_RFCOMM_TTY=y
CONFIG_BT_BNEP=m
CONFIG_BT_HIDP=m
CONFIG_BT_HCIBTUSB=m
CONFIG_BT_HCIUART=m
CONFIG_BT_HCIUART_H4=y
CONFIG_BT_HCIUART_3WIRE=y
CONFIG_BT_HCIBCM203X=m
CONFIG_BT_HCIBPA10X=m
CONFIG_BT_HCIBFUSB=m
CONFIG_BT_RTL=m

# =============================================
# NETHUNTER: RTL-SDR / DVB-USB
# =============================================
CONFIG_MEDIA_SUPPORT=m
CONFIG_MEDIA_USB_SUPPORT=y
CONFIG_MEDIA_SDR_SUPPORT=y
CONFIG_DVB_USB_V2=m
CONFIG_DVB_USB_RTL28XXU=m
CONFIG_DVB_RTL2830=m
CONFIG_DVB_RTL2832=m
CONFIG_DVB_RTL2832_SDR=m
CONFIG_USB_AIRSPY=m
CONFIG_USB_HACKRF=m

# =============================================
# NETHUNTER: USB Ethernet Adapters
# =============================================
CONFIG_USB_NET_DRIVERS=y
CONFIG_USB_USBNET=m
CONFIG_USB_NET_AX8817X=m
CONFIG_USB_NET_AX88179_178A=m
CONFIG_USB_NET_CDCETHER=m
CONFIG_USB_NET_CDC_EEM=m
CONFIG_USB_NET_CDC_NCM=m
CONFIG_USB_NET_RNDIS_HOST=m
CONFIG_USB_RTL8150=m
CONFIG_USB_RTL8152=m
CONFIG_USB_NET_SMSC95XX=m

# =============================================
# Networking / Firewall
# =============================================
CONFIG_NET=y
CONFIG_INET=y
CONFIG_IPV6=m
CONFIG_NETFILTER=y
CONFIG_NF_CONNTRACK=m
CONFIG_NF_NAT=m
CONFIG_NETFILTER_XTABLES=m
CONFIG_IP_NF_IPTABLES=m
CONFIG_IP_NF_FILTER=m
CONFIG_IP_NF_NAT=m
CONFIG_IP_NF_MANGLE=m
CONFIG_NF_TABLES=m
CONFIG_NF_TABLES_INET=y
CONFIG_NFT_NAT=m
CONFIG_NFT_MASQ=m
CONFIG_BRIDGE=m
CONFIG_TUN=m
CONFIG_VETH=m
CONFIG_MACVLAN=m
CONFIG_PACKET=y
CONFIG_UNIX=y
CONFIG_NET_KEY=m

# 802.1Q VLAN
CONFIG_VLAN_8021Q=m

# Wireless regulatory
CONFIG_WIRELESS_EXT=y
CONFIG_WEXT_SPY=y
CONFIG_WEXT_PRIV=y

# =============================================
# Filesystems
# =============================================
CONFIG_EXT4_FS=y
CONFIG_VFAT_FS=m
CONFIG_TMPFS=y
CONFIG_PROC_FS=y
CONFIG_SYSFS=y
CONFIG_FUSE_FS=m
CONFIG_NTFS3_FS=m
CONFIG_SQUASHFS=y

# =============================================
# Misc / Crypto
# =============================================
CONFIG_CRYPTO=y
CONFIG_CRYPTO_AES=y
CONFIG_CRYPTO_SHA256=y
CONFIG_CRYPTO_USER_API_HASH=m
CONFIG_CRYPTO_USER_API_SKCIPHER=m
CONFIG_MODULES=y
CONFIG_MODULE_UNLOAD=y
CONFIG_PRINTK=y
CONFIG_DEVTMPFS=y
CONFIG_DEVTMPFS_MOUNT=y
CONFIG_CGROUPS=y
CONFIG_NAMESPACES=y
CONFIG_NET_NS=y
CONFIG_INOTIFY_USER=y

# =============================================
# DISABLED: Phone / Modem (bloat removal)
# =============================================
# CONFIG_USB_SERIAL_OPTION is not set
# CONFIG_USB_SERIAL_QUALCOMM is not set
# CONFIG_USB_SERIAL_QMI is not set
# CONFIG_USB_NET_QMI_WWAN is not set
# CONFIG_USB_WDM is not set
```
